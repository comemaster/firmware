## west.yml
```yaml
manifest:
  remotes:
    - name: nordic
      url-base: https://github.com/nrfconnect
  projects:
    - name: sdk-nrf
      path: nrf
      remote: nordic
      revision: 15a350e0ee48787822bbc02c55c4068bbd09f097
      import: true
  self:
    path: firmware
```
